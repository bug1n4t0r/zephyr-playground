## prj.conf
```kconfig
CONFIG_SERIAL=y
CONFIG_GPIO=y
CONFIG_ADC=y
CONFIG_CONSOLE=y
CONFIG_PRINTK=y
CONFIG_CBPRINTF_FP_SUPPORT=y
```

## boards/nucleo_f411re.overlay
```dts
&adc1 {
    status = "okay";
    st,adc-prescaler = <4>;
    pinctrl-0 = <&adc1_in1_pa1 &adc1_in4_pa4 &adc1_in8_pb0>;
    pinctrl-names = "default";
};

// &pinctrl {
//     adc1_in1_pa1: adc1_in1_pa1 {
//         pinmux = STM32_PINMUX('A', 1, ANALOG);
//     };

//     adc1_in4_pa4: adc1_in4_pa4 {
//         pinmux = STM32_PINMUX('A', 4, ANALOG);
//     };

//     adc1_in8_pb0: adc1_in8_pb0 {
//         pinmux = STM32_PINMUX('B', 0, ANALOG);
//     };
// };
```

## src/main.c
```c
#include <zephyr/device.h>
#include <zephyr/drivers/adc.h>
#include <zephyr/drivers/gpio.h>
#include <zephyr/drivers/uart.h>
#include <zephyr/kernel.h>
#include <zephyr/sys/printk.h>

#define ADC_NODE DT_NODELABEL(adc1)
#if !DT_NODE_HAS_STATUS(ADC_NODE, okay)
  #error "Unsupported board: adc1 devicetree node is not okay"
#endif

static const struct device *const adc_dev = DEVICE_DT_GET(ADC_NODE);

static struct adc_channel_cfg ain1_ch_cfg = {
    .gain             = ADC_GAIN_1,
    .reference        = ADC_REF_INTERNAL,
    .acquisition_time = ADC_ACQ_TIME_DEFAULT,
    .channel_id       = 1,
    .differential     = 0,
};

static uint16_t adc_sample_buffer;

static struct adc_sequence adc_secqu = {
    .channels     = BIT(1),
    .buffer       = &adc_sample_buffer,
    .buffer_size  = sizeof(adc_sample_buffer),
    .resolution   = 12,
    .oversampling = 0,
    .calibrate    = false,
};

int main(void) {

  if (!device_is_ready(adc_dev)) {
    printk("ADC device not ready\n");
    return 1;
  }

  if (adc_channel_setup(adc_dev, &ain1_ch_cfg) != 0) {
    printk("Failed to setup ADC channel\n");
    return 1;
  }

  while (1) {
    int ret = adc_read(adc_dev, &adc_secqu);
    if (ret != 0) {
      printk("Failed to read ADC\n");
      return 1;
    }
    double v = 3.3 / 4069 * adc_sample_buffer;

    printk("ADC value: Raw: %d  (%.2f V)\n", adc_sample_buffer, v);

    k_sleep(K_MSEC(1000));
  }

  return 0;
}
```
